## main/Kconfig.projbuild
```kconfig
menu "Battery Tester Config"

    menu "Hardware GPIO Assignment"
        
        menu "I2C Buses"
            config I2C_SDA_PIN
                int "I2C SDA Pin (Primary: ADS1115)"
                default 4
            config I2C_SCL_PIN
                int "I2C SCL Pin (Primary: ADS1115)"
                default 5

            config I2C_OLED_SDA_PIN
                int "I2C SDA Pin (Secondary: OLED UI)"
                default 6
            config I2C_OLED_SCL_PIN
                int "I2C SCL Pin (Secondary: OLED UI)"
                default 7
        endmenu

        menu "User Interface (Input Only - Need Ext Pull-up)"
            config ENCODER_CLK_PIN
                int "Encoder CLK Pin"
                default 15
            config ENCODER_DT_PIN
                int "Encoder DT Pin"
                default 16
            config ENCODER_SW_PIN
                int "Encoder Button Pin"
                default 17
        endmenu

        menu "Sensors & Inputs"
            config TARE_BTN_PIN
                int "Dedicated Kelvin Probe Tare Button Pin"
                default 18

            config ONEWIRE_BUS_PIN
                int "OneWire Bus Pin (DS18B20)"
                default 8

            config ADC_ALERT_PIN
                int "ADS1115 Alert/Data Ready Pin"
                default 47
        endmenu

        menu "Power & Thermal Control (PWM Outputs)"
            config PWM_CH0_PIN
                int "MOSFET Gate Drive CH0"
                default 38
            config PWM_CH1_PIN
                int "MOSFET Gate Drive CH1"
                default 39
            config PWM_CH2_PIN
                int "MOSFET Gate Drive CH2"
                default 40
            config PWM_CH3_PIN
                int "MOSFET Gate Drive CH3"
                default 41

            config FAN_CH0_PIN
                int "Cooling Fan PWM CH0"
                default 42
            config FAN_CH1_PIN
                int "Cooling Fan PWM CH1"
                default 48
            config FAN_CH2_PIN
                int "Cooling Fan PWM CH2"
                default 1
            config FAN_CH3_PIN
                int "Cooling Fan PWM CH3"
                default 2
        endmenu

    endmenu

    menu "Safety Hard Limits"
        config MAX_HEATSINK_TEMP
            int "Max Heatsink Temp Cutoff (C)"
            default 65

        config MAX_DISCHARGE_CURRENT_MA
            int "Absolute Max Current Limit (mA)"
            default 3500

        config MIN_CELL_VOLTAGE_MV
            int "Absolute Min Cell Voltage (mV)"
            default 800
    endmenu

endmenu
```
